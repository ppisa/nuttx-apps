## examples/first_test/Kconfig
```kconfig
#
# For a description of the syntax of this configuration file,
# see the file kconfig-language.txt in the NuttX tools repository.
#

config EXAMPLES_FIRST_TEST
	tristate "\"First Test\" example"
	default n
	---help---
		Enable the \"First Test\" example

if EXAMPLES_FIRST_TEST

config EXAMPLES_FIRST_TEST_PROGNAME
	string "Program name"
	default "first_test"
	---help---
		This is the name of the program that will be used when the NSH ELF
		program is installed.

config EXAMPLES_FIRST_TEST_PRIORITY
	int "Hello task priority"
	default 100

config EXAMPLES_FIRST_TEST_STACKSIZE
	int "First test stack size"
	default DEFAULT_TASK_STACKSIZE

endif
```
